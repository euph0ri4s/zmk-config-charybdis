/*
 * Copyright (c) 2020 ZMK Contributors
 *
 * SPDX-License-Identifier: MIT
 */
 
#include "charybdis.dtsi"

&default_transform {
	col-offset = <4>;
};

//&five_column_transform {
//	col-offset = <5>;
//};

&kscan0 {
	col-gpios
		= <&xiao_d 0 (GPIO_ACTIVE_HIGH | GPIO_PULL_DOWN)>
		, <&xiao_d 1  (GPIO_ACTIVE_HIGH | GPIO_PULL_DOWN)>
		, <&xiao_d 2  (GPIO_ACTIVE_HIGH | GPIO_PULL_DOWN)>
		, <&xiao_d 3 (GPIO_ACTIVE_HIGH | GPIO_PULL_DOWN)>
		;
};

// trackball bus
&xiao_spi {
	status = "okay"; //okay
	sck-pin = <8>;
	mosi-pin = <9>;
	miso-pin = <9>; // same as mosi (3-wire spi) 
	// dipo = <10>;
	// dopo = <9>;
	cs-gpios = <&gpio0 9 GPIO_ACTIVE_LOW>;
};

&trackball {
	status = "okay"; //okay
	irq-gpios = <&gpio 2 (GPIO_ACTIVE_LOW | GPIO_PULL_UP)>;
};
