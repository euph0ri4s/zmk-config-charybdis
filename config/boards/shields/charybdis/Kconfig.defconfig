## config/boards/shields/charybdis/Kconfig.defconfig
```kconfig
if SHIELD_CHARYBDIS_RIGHT

config ZMK_KEYBOARD_NAME
	default "Charybdis"

config ZMK_SPLIT_BLE_ROLE_CENTRAL
	default y

endif

if SHIELD_CHARYBDIS_LEFT || SHIELD_CHARYBDIS_RIGHT

config ZMK_SPLIT
	default y
	
endif

config MOUSE_LAYER_INDEX
	int "Index of mouse layer"
	default 10

config SCROLL_LAYER_INDEX
	int "Index of scroll layer"
	default 5

config MOUSE_LAYER_ACTIVE_MS
	int "Mouse layer active time in ms"
	default 400
```
